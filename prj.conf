## CMakeLists.txt
```
cmake_minimum_required(VERSION 3.20.0)
find_package(Zephyr REQUIRED HINTS $ENV{ZEPHYR_BASE})
project(BeeNode1)

target_sources(app PRIVATE src/main.c)
```

## prj.conf
```kconfig
# --- Bluetooth ---
CONFIG_BT=y
CONFIG_BT_PERIPHERAL=y
CONFIG_BT_BROADCASTER=y
CONFIG_BT_GATT_SERVICE_CHANGED=y
CONFIG_BT_HCI=y
CONFIG_BT_CTLR=y
CONFIG_BT_CTLR_TX_PWR_PLUS_4=y

# --- System ---
CONFIG_PRINTK=y
CONFIG_SERIAL=y
CONFIG_ENTROPY_GENERATOR=y
CONFIG_HEAP_MEM_POOL_SIZE=2048
CONFIG_LOG=n

# --- GPIO ---
CONFIG_GPIO=y

# --- Float --- 
CONFIG_CBPRINTF_FP_SUPPORT=y

# --- Other timing ---
CONFIG_TIMESLICING=y

# --- Power Management ---
#CONFIG_PM=y
#CONFIG_PM_DEVICE=y
CONFIG_POWEROFF=y

# Allow use of WFI/WFE
CONFIG_CORTEX_M_SYSTICK=n
CONFIG_ZERO_LATENCY_IRQS=y

# Keep certain peripherals on (RTC1)
CONFIG_NRFX_RTC1=n
CONFIG_NRFX_CLOCK=n

# Button support
CONFIG_GPIO_GET_CONFIG=y


CONFIG_SENSOR=y
#CONFIG_HX711=y
CONFIG_CBPRINTF_FP_SUPPORT=y

# Obsluga pamieci nieulotnej (NVS / Settings) do zapisywania kalibracji
CONFIG_FLASH=y
CONFIG_FLASH_PAGE_LAYOUT=y
CONFIG_FLASH_MAP=y
CONFIG_NVS=y
CONFIG_SETTINGS=y
CONFIG_SETTINGS_NVS=y

# Obsluga czujnika temperatury 1-Wire przez UART
CONFIG_SENSOR=y
CONFIG_W1=y
CONFIG_W1_ZEPHYR_SERIAL=y
```

## src/main.c
```c
/**
 * ============================================================================
 * BeeNode - Beehive Monitoring System
 * ============================================================================
 * 
 * System monitorowania warunków w ulu pszczelim oparty na NRF52840 DK
 * 
 * Tryb pracy:
 * 1. Deep Sleep (System OFF) przez 10 minut
 * 2. Wybudzenie przez RTC lub Przyciski
 * 3. Advertising / Obsługa akcji (Test, Tara, Kalibracja)
 * 4. Powrót do Deep Sleep
 * 
 * Architektura BLE:
 * - NRF52840 = Peripheral (slave)
 * - Raspberry Pi = Central (master)
 * - Dane w GATT Service (nie tylko w advertising)
 * - UUID do identyfikacji serwisu i charakterystyk
 */
#include <zephyr/drivers/sensor.h>
#include <zephyr/kernel.h>
#include <zephyr/drivers/gpio.h>
#include <zephyr/sys/printk.h>
#include <zephyr/random/random.h>
#include <zephyr/bluetooth/bluetooth.h>
#include <zephyr/bluetooth/hci.h>
#include <zephyr/bluetooth/conn.h>
#include <zephyr/bluetooth/uuid.h>
#include <zephyr/bluetooth/gatt.h>
#include <nrfx.h>
#include <string.h>
#include <zephyr/sys/poweroff.h> // dla uzywania sys_poweroff()
#include <hal/nrf_gpio.h>
#include <hal/nrf_radio.h>
#include <hal/nrf_power.h>
#include <zephyr/settings/settings.h>

/* ============================================================================
 * KONFIGURACJA URZĄDZENIA (Łatwa edycja)
 * ============================================================================ */

// --- CZASY OPERACJI ---
#define SLEEP_INTERVAL_S          600    // Czas głębokiego snu między pomiarami (10 min)
#define TEST_ADV_DURATION_MS      15000  // Jak długo waga czeka na połączenie po kliknięciu TEST (15s)
#define TARE_LED_DURATION_MS      1500   // Jak długo świeci czerwona dioda przy Tarze (ms)
#define CAL_PREPARATION_S         10     // Czas na położenie ciężaru (mruganie zielonej diody)
#define CAL_MEASUREMENT_S         2      // Czas na stabilny odczyt (ciągłe światło zielone)
#define ADV_UPDATE_INTERVAL_MS    1000   // Odświeżanie danych w paczce Bluetooth (ms)

// --- MAPOWANIE DIOD (Aliasy z DeviceTree) ---
#define LED_GREEN_NODE            DT_ALIAS(extledgreen) // Zewnętrzna dioda na P1.15
#define LED_RED_NODE              DT_ALIAS(extledred)   // Zewnętrzna dioda na P1.14

// --- MAPOWANIE PINÓW (WAKE-UP) ---
// Uwaga: Te numery muszą zgadzać się z fizycznym podpięciem do nRF52840
#define PIN_BTN_TEST              11  // P0.11 (SW1 na DK)
#define PIN_BTN_TARE              12  // P0.12 (SW2 na DK)
#define PIN_BTN_CAL               24  // P0.24 (SW3 na DK)

// --- KONFIGURACJA HX711 ---
#define HX711_DT_PIN              27  // P0.27
#define HX711_SCK_PIN             26  // P0.26

static const struct device *gpio0_dev = DEVICE_DT_GET(DT_NODELABEL(gpio0));

// Inicjalizacja pinów
static void hx711_init(void) {
    if (!device_is_ready(gpio0_dev)) {
        printk("BLAD: Port GPIO0 nie jest gotowy!\n");
        return;
    }
    // Zegar jako wyjscie (stan niski na start), Dane jako wejscie
    gpio_pin_configure(gpio0_dev, HX711_SCK_PIN, GPIO_OUTPUT_INACTIVE);
    gpio_pin_configure(gpio0_dev, HX711_DT_PIN, GPIO_INPUT);
    printk("HX711 zainicjalizowany recznie (pin %d i %d)\n", HX711_SCK_PIN, HX711_DT_PIN);
}

// Funkcja bit-banging czytajaca dane z HX711
static int32_t hx711_read(void) {
    int32_t count = 0;
    int timeout = 10000; 

    // Czekaj az uklad bedzie gotowy (linia DT zejdzie na LOW)
    while (gpio_pin_get(gpio0_dev, HX711_DT_PIN) == 1 && timeout > 0) {
        k_busy_wait(10);
        timeout--;
    }

    if (timeout == 0) {
        printk("BLAD: Timeout - HX711 nie odpowiada!\n");
        return 0;
    }

    // Odczyt 24 bitow danych
    for (int i = 0; i < 24; i++) {
        gpio_pin_set(gpio0_dev, HX711_SCK_PIN, 1);
        k_busy_wait(1); // 1 mikrosekunda w gore
        count = count << 1;
        gpio_pin_set(gpio0_dev, HX711_SCK_PIN, 0);
        k_busy_wait(1); // 1 mikrosekunda w dol
        
        if (gpio_pin_get(gpio0_dev, HX711_DT_PIN)) {
            count++;
        }
    }

    // 25 impuls to ustawienie wzmocnienia na 128 dla kolejnego pomiaru
    gpio_pin_set(gpio0_dev, HX711_SCK_PIN, 1);
    k_busy_wait(1);
    gpio_pin_set(gpio0_dev, HX711_SCK_PIN, 0);
    k_busy_wait(1);

    // Format U2 (wartosci ujemne)
    if (count & 0x800000) {
        count |= 0xFF000000;
    }

    return count;
}


/* ============================================================================
 * PARAMETRY KALIBRACJI I PAMIĘĆ NVS
 * ============================================================================ */
int32_t tare_offset = -600000;         // Domyslna tara
float calib_factor = 1000000.0;        // Domyslny wspolczynnik
float known_weight_kg = 0.1835;         // WAGA REDMI NOTE 12 4g

// Funkcja obsługująca zapis/odczyt z pamięci flash (NVS)
static int scale_settings_set(const char *name, size_t len, settings_read_cb read_cb, void *cb_arg) {
    const char *next;
    if (settings_name_steq(name, "tare", &next) && !next) {
        if (len != sizeof(tare_offset)) return -EINVAL;
        read_cb(cb_arg, &tare_offset, sizeof(tare_offset));
        return 0;
    }
    if (settings_name_steq(name, "factor", &next) && !next) {
        if (len != sizeof(calib_factor)) return -EINVAL;
        read_cb(cb_arg, &calib_factor, sizeof(calib_factor));
        return 0;
    }
    return -ENOENT;
}

struct settings_handler scale_conf = {
    .name = "scale",
    .h_set = scale_settings_set,
};

/* ============================================================================
 * INTERFEJS: LED 1, LED 2, PRZYCISK SW2 (Tara), PRZYCISK SW3 (Kalibracja)
 * ============================================================================ */
// --- LED i Timer do mrugania w tle ---
static const struct gpio_dt_spec led0 = GPIO_DT_SPEC_GET(LED_GREEN_NODE, gpios);
static const struct gpio_dt_spec led1 = GPIO_DT_SPEC_GET(LED_RED_NODE, gpios);

static void led_timer_isr(struct k_timer *timer_id) {
    gpio_pin_toggle_dt(&led0); // Zmiana stanu diody na przeciwny
}
K_TIMER_DEFINE(led_blink_timer, led_timer_isr, NULL);

enum led_mode { LED_OFF, LED_BLINK_SLOW, LED_BLINK_FAST };

static void set_led_mode(enum led_mode mode) {
    if (!device_is_ready(led0.port)) return;
    
    if (mode == LED_OFF) {
        k_timer_stop(&led_blink_timer);
        gpio_pin_set_dt(&led0, 0); // Wylacz diode
    } else if (mode == LED_BLINK_SLOW) {
        k_timer_start(&led_blink_timer, K_MSEC(500), K_MSEC(500)); // Mruga co pol sekundy
    } else if (mode == LED_BLINK_FAST) {
        k_timer_start(&led_blink_timer, K_MSEC(100), K_MSEC(100)); // Mruga bardzo szybko
    }
}

// Struktury dla przycisków (do odczytu stanu)
static const struct gpio_dt_spec btn_tare_spec = GPIO_DT_SPEC_GET(DT_ALIAS(sw1), gpios);
static const struct gpio_dt_spec btn_cal_spec = GPIO_DT_SPEC_GET(DT_ALIAS(sw2), gpios);

static int ui_setup(void) {
    // 1. Inicjalizacja LED0 (Zielona)
    if (device_is_ready(led0.port)) {
        gpio_pin_configure_dt(&led0, GPIO_OUTPUT_INACTIVE);
    }

    // 2. Inicjalizacja LED1 (Czerwona)
    if (device_is_ready(led1.port)) {
        gpio_pin_configure_dt(&led1, GPIO_OUTPUT_INACTIVE);
    }

    // 3. Inicjalizacja Przycisku SW2 (Tara)
    if (device_is_ready(btn_tare_spec.port)) {
        gpio_pin_configure_dt(&btn_tare_spec, GPIO_INPUT | GPIO_PULL_UP);
    } else {
        printk("WARN: Przycisk SW2 niedostepny!\n");
    }

    // 4. Inicjalizacja Przycisku SW3 (Kalibracja)
    if (device_is_ready(btn_cal_spec.port)) {
        gpio_pin_configure_dt(&btn_cal_spec, GPIO_INPUT | GPIO_PULL_UP);
    } else {
        printk("WARN: Przycisk SW3 niedostepny!\n");
    }

    printk("Gotowe! SW1: Test (Wybudzenie), SW2: Tara, SW3: Kalibracja, LED0/LED1: status.\n");
    return 0;
}

/* ============================================================================
 * POMOCNICZA: UŚREDNIANIE (jak w Arduino)
 * ============================================================================ */
static int32_t hx711_read_average(int times) {
    int64_t sum = 0;
    for (int i = 0; i < times; i++) {
        sum += hx711_read();
        k_sleep(K_MSEC(10)); // Krotka przerwa miedzy odczytami
    }
    return (int32_t)(sum / times);
}

/* ============================================================================
 * DANE BLUETOOTH (Zmienne globalne dla GATT)
 * ============================================================================ */
uint16_t current_weight_ble = 0;       // Waga dla BLE (rozdzielczosc 0.005 kg)
uint8_t  current_battery_level = 88;   // Procent baterii (0-100%)
uint16_t current_battery_voltage = 395;// Napiecie baterii (395 = 3.95V)
int16_t  current_temperature = 2250;   // Temperatura (2250 = 22.50 °C)


/* ============================================================================
 * CZUJNIK TEMPERATURY DS18B20
 * ============================================================================ */
static const struct device *ds18b20_dev = DEVICE_DT_GET_ANY(maxim_ds18b20);

static int16_t read_real_temperature(void) {
    if (!device_is_ready(ds18b20_dev)) {
        printk("WARN: Czujnik DS18B20 nie jest podlaczony lub gotowy!\n");
        return 2250; // Wartosc awaryjna (22.50 st C) jesli czujnik odpadnie
    }

    struct sensor_value temp;
    if (sensor_sample_fetch(ds18b20_dev) == 0) {
        sensor_channel_get(ds18b20_dev, SENSOR_CHAN_AMBIENT_TEMP, &temp);
        double temp_c = sensor_value_to_double(&temp);
        int16_t temp_x100 = (int16_t)(temp_c * 100);
        // printk(">>> DS18B20: %.2f st. C (do BLE: %d) <<<\n", temp_c, temp_x100);
        return temp_x100;
    }
    
    printk("Blad odczytu DS18B20!\n");
    return 2250;
}


/* ============================================================================
 * BLUETOOTH - ADVERTISING (Nowy Standard)
 * ============================================================================ */
// Company ID (0xFFFE) | DeviceType (0xA1) | Sensor ID (4 Bajty)
static uint8_t mfg_data[7] = {0xFE, 0xFF, 0xA1, 0x00, 0x00, 0x00, 0x00};

static const struct bt_data ad[] = {
    BT_DATA_BYTES(BT_DATA_FLAGS, BT_LE_AD_GENERAL | BT_LE_AD_NO_BREDR),
    BT_DATA(BT_DATA_MANUFACTURER_DATA, mfg_data, sizeof(mfg_data)),
};

static const struct bt_data sd[] = {
    BT_DATA(BT_DATA_NAME_COMPLETE, "BeeNode", 7),
};

/* ============================================================================
 * BLUETOOTH - CALLBACKI ODCZYTU (GATT)
 * ============================================================================ */
// 1. ODCZYT WAGI (Flags 1B + Waga 2B)
static ssize_t read_weight(struct bt_conn *conn, const struct bt_gatt_attr *attr, void *buf, uint16_t len, uint16_t offset) {
    uint8_t payload[3];
    payload[0] = 0x00; // Flaga: Waga w kilogramach (SI)
    payload[1] = current_weight_ble & 0xFF;        // mlodszy bajt
    payload[2] = (current_weight_ble >> 8) & 0xFF; // starszy bajt
    return bt_gatt_attr_read(conn, attr, buf, len, offset, payload, sizeof(payload));
}

// 2. ODCZYT PROCENTÓW BATERII
static ssize_t read_bat_level(struct bt_conn *conn, const struct bt_gatt_attr *attr, void *buf, uint16_t len, uint16_t offset) {
    return bt_gatt_attr_read(conn, attr, buf, len, offset, &current_battery_level, sizeof(current_battery_level));
}

// 3. ODCZYT NAPIĘCIA BATERII
static ssize_t read_bat_voltage(struct bt_conn *conn, const struct bt_gatt_attr *attr, void *buf, uint16_t len, uint16_t offset) {
    return bt_gatt_attr_read(conn, attr, buf, len, offset, &current_battery_voltage, sizeof(current_battery_voltage));
}

// 4. ODCZYT TEMPERATURY
static ssize_t read_temperature(struct bt_conn *conn, const struct bt_gatt_attr *attr, void *buf, uint16_t len, uint16_t offset) {
    return bt_gatt_attr_read(conn, attr, buf, len, offset, &current_temperature, sizeof(current_temperature));
}

/* ============================================================================
 * BLUETOOTH - DEFINICJA STRUKTURY SERWISÓW (GATT TREE)
 * ============================================================================ */
// UUID dla Napięcia (Niestandardowe, z dokumentacji)
static struct bt_uuid_128 bat_volt_uuid = BT_UUID_INIT_128(
    BT_UUID_128_ENCODE(0x0000FFF2, 0x0000, 0x1000, 0x8000, 0x00805F9B34FB)
);

BT_GATT_SERVICE_DEFINE(beenode_svc,
    // --- SERWIS WAGI (Weight Scale: 0x181D) ---
    BT_GATT_PRIMARY_SERVICE(BT_UUID_DECLARE_16(0x181D)),
    BT_GATT_CHARACTERISTIC(BT_UUID_DECLARE_16(0x2A9D), BT_GATT_CHRC_READ, BT_GATT_PERM_READ, read_weight, NULL, NULL),

    // --- SERWIS BATERII (Battery Service: 0x180F) ---
    BT_GATT_PRIMARY_SERVICE(BT_UUID_BAS),
    BT_GATT_CHARACTERISTIC(BT_UUID_BAS_BATTERY_LEVEL, BT_GATT_CHRC_READ, BT_GATT_PERM_READ, read_bat_level, NULL, NULL),
    BT_GATT_CHARACTERISTIC(&bat_volt_uuid.uuid, BT_GATT_CHRC_READ, BT_GATT_PERM_READ, read_bat_voltage, NULL, NULL),

    // --- SERWIS TEMPERATURY (Environmental Sensing: 0x181A) ---
    BT_GATT_PRIMARY_SERVICE(BT_UUID_ESS),
    BT_GATT_CHARACTERISTIC(BT_UUID_DECLARE_16(0x2A6E), BT_GATT_CHRC_READ, BT_GATT_PERM_READ, read_temperature, NULL, NULL)
);

/* ============================================================================
 * AKTUALIZACJA DANYCH BLUETOOTH (Zastępuje stare update_sensor_frame)
 * ============================================================================ */
static void update_ble_data(void)
{
    // 1. Wpisz unikalne ID mikrokontrolera do paczki Advertisingu
    uint32_t dev_id = NRF_FICR->DEVICEID[0];
    mfg_data[3] = (dev_id >> 24) & 0xFF;
    mfg_data[4] = (dev_id >> 16) & 0xFF;
    mfg_data[5] = (dev_id >> 8)  & 0xFF;
    mfg_data[6] = dev_id & 0xFF;
    
    // 2. Przelicz aktualna wage na standard BLE
    int32_t raw_val = hx711_read();
    int32_t weight_no_tare = tare_offset - raw_val;
    if (weight_no_tare < 0 && weight_no_tare > -5000) weight_no_tare = 0; 
    
    double weight_kg = (double)weight_no_tare / calib_factor;
    
    // Zgodnie z wytycznymi: rozdzielczość 0.005 kg
    // Żeby uzyskać wartość dla BLE matematycznie: waga / 0.005 (czyli waga * 200)
    current_weight_ble = (uint16_t)(weight_kg * 200.0);

    // 3. Pobierz prawdziwa temperature z DS18B20 do GATT
    current_temperature = read_real_temperature();
    // -----------------
}

/* ============================================================================
 * BLUETOOTH - CONNECTION CALLBACKS
 * ============================================================================ */

static struct bt_conn *current_conn = NULL;

static void connected(struct bt_conn *conn, uint8_t err)
{
    if (err) {
        printk("BLE: Błąd połączenia: %u\n", err);
        return;
    }

    char addr[BT_ADDR_LE_STR_LEN];
    bt_addr_le_to_str(bt_conn_get_dst(conn), addr, sizeof(addr));
    printk("BLE: Połączono z %s\n", addr);
    
    current_conn = bt_conn_ref(conn);
}

static void disconnected(struct bt_conn *conn, uint8_t reason)
{
    char addr[BT_ADDR_LE_STR_LEN];
    bt_addr_le_to_str(bt_conn_get_dst(conn), addr, sizeof(addr));
    printk("BLE: Rozłączono z %s (powód: %u)\n", addr, reason);
    
    if (current_conn) {
        bt_conn_unref(current_conn);
        current_conn = NULL;
    }
}

BT_CONN_CB_DEFINE(conn_callbacks) = {
    .connected = connected,
    .disconnected = disconnected,
};

/* ============================================================================
 * BLUETOOTH - INICJALIZACJA
 * ============================================================================ */

static void bt_ready(int err)
{
    if (err) {
        printk("BLE: Błąd inicjalizacji: %d\n", err);
        return;
    }
    printk("BLE: Stack gotowy\n");
}

/* ============================================================================
 * ADVERTISING - ZARZĄDZANIE
 * ============================================================================ */

/**
 * Rozpoczyna advertising z szybkim interwałem
 * Umożliwia szybkie wykrycie przez RPi
 */
static int start_advertising(void)
{
    // DEBUGOWANIE: Sprawdź rozmiary
    // printk("DEBUG: sizeof(sensor_frame_t) = %u\n", sizeof(struct sensor_frame_t));
    // printk("DEBUG: sizeof(mfg_data) = %u\n", sizeof(mfg_data));
    // printk("DEBUG: Total AD payload = %u bytes\n", 
    //        3 + sizeof(mfg_data) + 2);  // FLAGS + MFG_DATA + overhead
    
    // Sprawdź czy BT jest gotowy
    if (!bt_is_ready()) {
        printk("ERROR: Bluetooth nie jest gotowy!\n");
        return -EAGAIN;
    }

    struct bt_le_adv_param adv_param = {
        .id = BT_ID_DEFAULT,
        .options = BT_LE_ADV_OPT_CONNECTABLE |
                   BT_LE_ADV_OPT_USE_TX_POWER,  // Usunięto USE_NAME
        .interval_min = BT_GAP_ADV_FAST_INT_MIN_2,  // 100 ms
        .interval_max = BT_GAP_ADV_FAST_INT_MAX_2,  // 150 ms
    };

    int err = bt_le_adv_start(&adv_param, ad, ARRAY_SIZE(ad), sd, ARRAY_SIZE(sd));
    if (err) {
        printk("ERROR: Błąd startu advertising: %d\n", err);
        return err;
    }

    printk("BLE: Advertising rozpoczęty ✓\n");
    return 0;
}

/**
 * Zatrzymuje advertising
 */
static void stop_advertising(void)
{
    int err = bt_le_adv_stop();
    if (err) {
        printk("BLE: Błąd zatrzymania advertising: %d\n", err);
    } else {
        printk("BLE: Advertising zatrzymany\n");
    }
}

/* ============================================================================
 * DEEP SLEEP (SYSTEM OFF)
 * ============================================================================ */

/**
 * Przechodzi w tryb System OFF z wybudzeniem przez RTC i Przyciski
 * 
 * @param seconds Czas snu w sekundach
 */
static void enter_deep_sleep(uint32_t seconds)
{
    printk("Zasypiam na %u sekund\n", seconds);

    /* 1. Start LFCLK (RTC tego wymaga) */
    NRF_CLOCK->TASKS_LFCLKSTART = 1;
    while (!NRF_CLOCK->EVENTS_LFCLKSTARTED);
    NRF_CLOCK->EVENTS_LFCLKSTARTED = 0;

    /* 2. Konfiguracja RTC1 */
    NRF_RTC1->TASKS_STOP = 1;
    NRF_RTC1->TASKS_CLEAR = 1;
    NRF_RTC1->PRESCALER = 0; // 32768 Hz

    uint32_t ticks = seconds * 32768;
    if (ticks > 0x00FFFFFF) {
        ticks = 0x00FFFFFF;
    }

    NRF_RTC1->CC[0] = ticks;
    NRF_RTC1->EVENTS_COMPARE[0] = 0;
    NRF_RTC1->EVTENSET = RTC_EVTENSET_COMPARE0_Msk;
    NRF_RTC1->TASKS_START = 1;

    /* 3. Wake-up z przycisków */
    uint32_t wakeup_pins[] = {PIN_BTN_TEST, PIN_BTN_TARE, PIN_BTN_CAL};
    for (int i = 0; i < 3; i++) {
        NRF_GPIO->PIN_CNF[NRF_GPIO_PIN_MAP(0, wakeup_pins[i])] =
            (GPIO_PIN_CNF_SENSE_Low << GPIO_PIN_CNF_SENSE_Pos) |
            (GPIO_PIN_CNF_PULL_Pullup << GPIO_PIN_CNF_PULL_Pos) |
            (GPIO_PIN_CNF_INPUT_Connect << GPIO_PIN_CNF_INPUT_Pos) |
            (GPIO_PIN_CNF_DIR_Input << GPIO_PIN_CNF_DIR_Pos);
    }

    printk("SYSTEM OFF\n");

    /* 4. System OFF */
    NRF_POWER->SYSTEMOFF = 1;

    while (1) {
        __WFE();
    }
}


/* ============================================================================
 * MAIN LOOP
 * ============================================================================ */

int main(void)
{
    printk("\n");
    printk("========================================\n");
    printk("  BeeNode - Beehive Monitor v1.0\n");
    printk("========================================\n");
    printk("Board: NRF52840 DK\n");
    printk("Build: %s %s\n", __DATE__, __TIME__);
    printk("========================================\n\n");

    // Inicjalizacja naszej wagi
    hx711_init();

    // Inicjalizacja interfejsu
    ui_setup();

    // --- Inicjalizacja i wczytanie pamieci ---
    settings_subsys_init();
    settings_register(&scale_conf);
    settings_load();
    printk("Zaladowano z pamieci NVS -> Tara: %d, Wspolczynnik: %.1f\n", tare_offset, calib_factor);
    // -----------------------------------------

    // Inicjalizacja Bluetooth
    int err = bt_enable(bt_ready);
    if (err) {
        printk("FATAL: Bluetooth enable failed: %d\n", err);
        return err;
    }
    k_sleep(K_MSEC(500));  // Daj czas na inicjalizację

    // --- TX POWER +4 dBm ---
    // Ustaw TX power radia na +4 dBm (nRF52840)
    NRF_RADIO->TXPOWER = RADIO_TXPOWER_TXPOWER_Pos4dBm;
    printk("TX power ustawiony na +4 dBm (RADIO)\n");

    printk("\n=== GŁÓWNA PĘTLA PROGRAMU ===\n\n");

    // Odczytaj rejestr LATCH (zapisuje piny, ktore wybudzily z System OFF)
    uint32_t latch = NRF_P0->LATCH;
    NRF_P0->LATCH = 0xFFFFFFFF; // Wyczyść LATCH

    // Sprawdzamy czy wybudzenie nastapilo z konkretnego pinu, lub czy jest on wciaz wcisniety
    bool is_tare = (latch & (1 << PIN_BTN_TARE)) || (gpio_pin_get_dt(&btn_tare_spec) == 1);
    bool is_cal = (latch & (1 << PIN_BTN_CAL)) || (gpio_pin_get_dt(&btn_cal_spec) == 1);

    if (is_tare) {
        printk(">>> TRYB: TARE (Zapis punktu zerowego)\n");
        printk("Pusto na wadze. Zrozumiałem, zapisałem nowe zero.\n");
        
        gpio_pin_set_dt(&led1, 1); // Zapal LED2 (Czerwona)
        
        tare_offset = hx711_read_average(10); // Odczyt i usrednienie
        settings_save_one("scale/tare", &tare_offset, sizeof(tare_offset));
        
        k_sleep(K_MSEC(TARE_LED_DURATION_MS));
        gpio_pin_set_dt(&led1, 0); // Zgas LED2
        
    } else if (is_cal) {
        printk(">>> TRYB: CALIBRATION (Kalibracja odważnikiem)\n");
        
        // Faza 1: Pulsowanie (czas na reakcje)
        printk("Masz %d sekund, żeby spokojnie położyć ciężar na szali...\n", CAL_PREPARATION_S);
        set_led_mode(LED_BLINK_FAST);
        k_sleep(K_SECONDS(CAL_PREPARATION_S));
        
        // Faza 2: Zapis (Swiatlo ciagle)
        set_led_mode(LED_OFF);
        gpio_pin_set_dt(&led0, 1);
        printk("Czytam wage...\n");
        
        int32_t reading = hx711_read_average(10);
        calib_factor = (float)(tare_offset - reading) / known_weight_kg;
        settings_save_one("scale/factor", &calib_factor, sizeof(calib_factor));
        
        printk(">>> Wspolczynnik wyliczony! (Wartosc: %.1f)\n", calib_factor);
        k_sleep(K_SECONDS(CAL_MEASUREMENT_S));
        gpio_pin_set_dt(&led0, 0);
        
    } else {
        printk(">>> TRYB: TEST (Szybki pomiar)\n");
        printk("Obudziłem się, robię szybki pomiar i wracam do spania.\n");
        
        // Zapal zielona diode na 1 sekunde
        gpio_pin_set_dt(&led0, 1);
        k_sleep(K_SECONDS(1));
        gpio_pin_set_dt(&led0, 0);
        
        // Odczyt, puszcza sygnal BLE i spi
        update_ble_data();
        
        err = start_advertising();
        if (!err) {
            // Szybka wysylka
            uint64_t adv_start_time = k_uptime_get();
            while (k_uptime_get() - adv_start_time < TEST_ADV_DURATION_MS) {
                if (current_conn) {
                    printk("BLE: Połączono - trzymam połączenie 30 sekund...\n");

                    uint64_t conn_start = k_uptime_get();

                    while (k_uptime_get() - conn_start < 30000) {
                        // Możesz aktualizować dane co sekundę
                        update_ble_data();
                        k_sleep(K_MSEC(1000));
                    }

                    printk("BLE: Rozłączam po 30 sekundach\n");
                    bt_conn_disconnect(current_conn, BT_HCI_ERR_REMOTE_USER_TERM_CONN);
                    break;
                }
                if ((k_uptime_get() - adv_start_time) % ADV_UPDATE_INTERVAL_MS == 0) {
                    update_ble_data();
                    bt_le_adv_update_data(ad, ARRAY_SIZE(ad), sd, ARRAY_SIZE(sd));
                }
                k_sleep(K_MSEC(100));
            }
            stop_advertising();
        }
    }

    // Powrot do spania
    enter_deep_sleep(SLEEP_INTERVAL_S);

    return 0;
}
```
