## build_1/BeeNode1/Kconfig/boards/Kconfig.defconfig
```kconfig
# Load Zephyr board defconfig descriptions.
osource "C:/ncs/v3.1.1/zephyr/boards/nordic/nrf52840dk/Kconfig.defconfig"
```

## build_1/BeeNode1/Kconfig/boards/Kconfig.nrf52840dk
```kconfig
# Load board Kconfig descriptions.
osource "C:/ncs/v3.1.1/zephyr/boards/nordic/nrf52840dk/Kconfig.nrf52840dk"
```
